//************************************************************************************************
//
// File:            DCCHardware-DxCore.inc
// Purpose:         DCC Waveform Generator for DxCore processors (e.g. AVR DA/DB/EA)
// Copyright 2026:  Aiko Pras
// History:         2026-03-09 / Aiko Pras - First version
//// Resources:
// - DCC pin: this should be one of the possible TCA0 Waveform Output pins.
//   Pins 0, 1 and 2 of every port can be used for this.
// - AUX pin: this should be either PIN_PA4 or PIN_PA5
// - TCA0: this timer may not be used elsewhere within the code
// - TCD0: this timer may not be used elsewhere within the code
//
// Design choices
// ==============
// This driver uses two AVR timers: TCA0 for the DCC signal, and TCD0 for the RailCom cutout.
//
// TCA0 is used in single-slope PWM mode. After each PWM signal an ISR is called
// in which the CMP/PER register values should be entered for the next DCC PWM pulse.
// In this way TCA0 will generate a jitter-free DCC signal, provided that the CMP/PER
// register values are entered before the next transition occurs.
// In practice we will have up to 50us headroom for entering these values.
//
// The original idea was to use TCA in split mode. Channel 1 is for the DCC pin, channel 2 is
// for the AUX pin. Unfortunately, in split mode only one of both channels is able to generate
// interrupts. Therefore split mode TCA cannot be used.
//
// Therefore the RailCom cutout signal on the AUX pin is generated by the TCD timer. TCD is a
// relatively complex timer that is hardly used by other Arduino libraries.
//
// Buffered versus unbuffered registers
// ====================================
// The TCA peripheral offers two options for updating PER/CMP registers:
// 1) Buffered registers:
//    - Updates take effect *after* the current period completes.
//    - Pros: extra headroom for setting next bit (e.g., 116us).
//    - Cons: AUX/RailCom cutout must be delayed by one bit or compensated,
//      as the new bit timing is only applied in the next period.
// 2) Direct (unbuffered) registers:
//    - Updates take effect immediately for the next cycle.
//    - Pros: allows exact synchronization of AUX/RailCom cutouts with DCC bits.
//    - Cons: less headroom (e.g., 58us) to prepare the next bit.
// For precise RailCom AUX timing, this code uses direct register updates.
// Buffered registers may become useful if execution of the TCA ISR is delayed
// for more than 50us.
//
// Ping-pong buffer
// ================
// The ESP32-RMT driver uses a ping-pong buffer to feed two RMT queues. Associating the ping-pong
// buffers directly with the (in this case TCA) timer is not suitable here, since copying an array
// of waveform "symbols" (memcpy) is too expensive to perform inside the ISR (measured: 50us).
//
// Therefore this TCA driver uses a different approach: the ping-pong mechanism is moved to the
// packet level and associated with the send() call instead of the timer hardware.
//
// Two packet buffers are used:
//  - sendPacketIndex : owned by send(), indicates which buffer is currently being filled.
//  - isrPacketIndex  : owned by the ISR, indicates which buffer is currently being transmitted.
//
// The send() function prepares a complete packet in the buffer selected by sendPacketIndex and
// signals when it is ready. The ISR never modifies this buffer while it is being filled. Instead,
// at the end of a transmission the ISR switches isrPacketIndex to the next ready buffer.
//
// This producer/consumer separation avoids race conditions and keeps the ISR execution time
// constant, since the ISR only switches pointers and never performs memcpy operations.
//
//************************************************************************************************
#include <Arduino.h>
#include "../DCCHardware.h"

//================================================================================================
//                                      Defines
//================================================================================================
// TCA clock = CLK_PER = F_CPU (typically 24 MHz)
// 1 tick = 1 / F_CPU seconds
// The timer counts are calculated from the selected clockspeed, and are therefore dynamic
#define TICKS_PER_US    (F_CPU / 1000000UL)
#define ZERO            (TICKS_PER_US * (200))      // RCN-210: zero bit       (195.... us)
#define ONE             (TICKS_PER_US * (116))      // RCN-210: one bit        (110..122 us)
#define TCS             (TICKS_PER_US * ( 29))      // RCN-217: cutout start   (26..32 us)
#define TCE             (TICKS_PER_US * (463))      // RCN-217: cutout end     (454..488 us)

#define MAX_SYMBOLS 128             // Long enough to hold a 6 byte DCC packet

#define RAILCOM_CUTOUT_LENGTH 4     // see RCN-217 (Ausgabe 24.11.2025)

// TCD clock (for the Railcom Cutout)
#define CUTOUT_OFFSET 6UL     // Compensation for the ISR start time)
#define TCD_PRESCALER 4UL
#define TCD_TCS (TICKS_PER_US * (116UL +  29UL - CUTOUT_OFFSET) / TCD_PRESCALER)
#define TCD_TCE (TICKS_PER_US * (116UL + 463UL - CUTOUT_OFFSET) / TCD_PRESCALER)


//================================================================================================
//                            A: Objects and Internal Data Structures
//================================================================================================

//************************************************************************************************
// A.1. Constructor definition and instantiation
//************************************************************************************************
DccPacketEngine::DccPacketEngine(){
  dccRailPin = PIN_PD0;                           // Pin for DCC rail Signal, with RailCom support
  dccRailAuxPin = PIN_PA4;                        // Pin for Enable and RailCom gap (optional)
  dccMonitorPin = 0xFF;                           // Not use in this HQ variant
}

// dccPacketEngine is the object that controls packet transmission for different hardware
DccPacketEngine dccPacketEngine;


//************************************************************************************************
// A.2. Declaration and initialisation of internal data structures
//************************************************************************************************
typedef struct {
  uint16_t per;
  uint16_t cmp;
} dcc_waveform_symbol_t;

struct DccPacket {
  dcc_waveform_symbol_t symbols[MAX_SYMBOLS];
  uint8_t numberOfSymbols;
};

struct DccSymbols {
  dcc_waveform_symbol_t one;    // DCC "1"
  dcc_waveform_symbol_t zero;   // DCC "0"
  dcc_waveform_symbol_t endbit; // DCC "1"
  dcc_waveform_symbol_t gap;    // Railcom gap
};
static DccSymbols s;            // Short name, to improve readability in (inline) helper functions


struct DccTxEngine {                      // Processor independent
  bool isInitialized = false;             // Flag to ensure we initialise only once
  // Aux pin
  uint8_t auxPin;                         // Pin for the Power ON/OFF / RailCom cutout
  bool auxPinConfigured;                  // To protect against invalid pin values
  bool auxOutputActive = false;           // Flag used by RunOutputSignal / StopOutputSignal
  // User Packet
  DccPacket userPacket[2];                // packet ping-pong buffer
  uint8_t sendPacketIndex;                // owned by send()
  volatile uint8_t isrPacketIndex;        // owned by ISR
  volatile bool userPacketReady;          // send() → ISR handover flag
  // Prepared packets
  DccPacket idlePacket;                   // Precomputed idle packet
  DccPacket resetPacket;                  // Precomputed reset packet
  DccPacket* defaultPacket;               // Pointer to either an idle or a reset packet
  // Railcom
  bool railComAllowedOnDcc = false;       // DCC pin: should a RC gap be generated in the DCC signal?
  bool railComAllowedOnAux = false;       // AUX pin: is this pin (also) used for the RailCom gap?
  volatile bool railComActiveOnAux;       // Timer ISR: should a RC gap be generated in the Aux signal
  volatile bool railComCutoutInProgress;  // Set flag at RC gap start, clear at RC gap end
  // Service Mode
  volatile bool smActive;                 // SM active (long preamble, resets, SM flow allowed)
  volatile bool isServiceModePacket;      // We have to send Service Mode Packets
  volatile uint8_t smRepeatsRemaining;    // Number of retransmissions left for this SM packet
  volatile uint8_t smMaxRepeats = 10;     // Number of SM retransmissions after first send
  // Preamble length
  uint8_t preambleLength = 17;            // Length of the preamble in normal operation
  uint8_t preambleLengthSM = 20;          // Length of the preamble in Service Mode
  // Polarity of the DCC signal
  bool dccSignalInverted = false;
};

struct TcaTxEngine {                      // Processor dependent
  // The TCA hardware switches between two ping-pong queues with TCA symbols
  volatile DccPacket* activePacket;       // The current packet that the TCA is sending
  uint8_t currentSymbolIndex;             // 0.. MAX_SYMBOLS
  // And we allow the choice between al available compare Units
  volatile uint16_t* compareUnitRegister;
  uint8_t compareUnitMask;
  // Finally a pointer to the DCC output PORTx.PINnCTRL
  volatile uint8_t* pinCtrlRegister = nullptr;
};

// Object instantiation
static DccTxEngine dccTx;                 // This object holds generic data
static TcaTxEngine tcaTx;                 // This object holds TCA specific data


// Note that we do not (re)set railComAllowedOnDcc, railComAllowedOnAux,
// smMaxRepeats, preambleLength, preambleLengthSM and dccSignalInverted,
// since the user may already have set these values.
static void initTxEngines() {
  // Aux pin state / Railcom
  dccTx.railComActiveOnAux = dccTx.railComAllowedOnAux;
  dccTx.railComCutoutInProgress = false;
  // Service Mode settings
  dccTx.smActive = false;
  dccTx.isServiceModePacket = false;
  dccTx.smRepeatsRemaining = 0;
  // Clear the user packet
  dccTx.userPacket[0].numberOfSymbols = 0;
  dccTx.userPacket[1].numberOfSymbols = 0;
  dccTx.userPacketReady = false;
  dccTx.sendPacketIndex = 0;
  dccTx.isrPacketIndex  = 1;                  // opposite of dccTx.sendPacketIndex
  // Initialise the default packet
  dccTx.defaultPacket = &dccTx.idlePacket;
  // TCA specific
  tcaTx.activePacket = dccTx.defaultPacket;   // start met idle via defaultPacket
  tcaTx.currentSymbolIndex = 0;
}


//================================================================================================
//                      B: Helper Functions for DCC Bits and Aux Pin
//================================================================================================

//************************************************************************************************
// B1: Aux pin
//************************************************************************************************
// The dccRailAuxPin serves two related purposes: when enabled via RunOutputSignal(), it
// forces the Aux pin to the active level to enable an H-Bridge, but it can also be
// automatically toggled during a RailCom cutout to generate the RailCom gap.
//
// initAuxPin() is called only once, at the start of setupWaveformGenerator, thus before the
// RailCom timer is initialised. enableAuxOutput() and disableAuxOutput() should not be called
// if the AUX pin is captured by the Railcom timer (TCD)
//
// Since this driver uses the DxCore pin control to change the polarity of the AUX pin
// the enable value is always LOW and disable is always HIGH.
static inline void enableAuxOutput() {
  if (!dccTx.auxPinConfigured) return;
  if (dccTx.auxPin == PIN_PA4) digitalWriteFast(PIN_PA4, LOW);
  else digitalWriteFast(PIN_PA5, LOW);
}

static inline void disableAuxOutput() {
  if (!dccTx.auxPinConfigured) return;
  if (dccTx.auxPin == PIN_PA4) digitalWriteFast(PIN_PA4, HIGH);
  else digitalWriteFast(PIN_PA5, HIGH);
}


static inline void initAuxPin() {
  // The AUX pin wil not be used if its value is an invalid pin (such as 0xFF)
  if ((dccPacketEngine.dccRailAuxPin == PIN_PA4) || (dccPacketEngine.dccRailAuxPin == PIN_PA5)) {
    dccTx.auxPinConfigured = true;
    dccTx.auxPin = dccPacketEngine.dccRailAuxPin;
    pinMode(dccTx.auxPin, OUTPUT);
    disableAuxOutput();     // default off.
  }
  else {
    dccTx.auxPinConfigured = false;
    dccPacketEngine.dccRailAuxPin = 0xFF;
  }
}

// setAuxPinInverted may be called at any moment in time.
void setAuxPinInverted(bool inverted) {
  if (dccTx.auxPin == PIN_PA4) {
    if (inverted) PORTA.PIN4CTRL |= PORT_INVEN_bm;
    else PORTA.PIN4CTRL &= ~PORT_INVEN_bm;
  }
  else if (dccTx.auxPin == PIN_PA5) {
    if (inverted) PORTA.PIN5CTRL |= PORT_INVEN_bm;
    else PORTA.PIN5CTRL &= ~PORT_INVEN_bm;
  }
}


//************************************************************************************************
// B.2 Translating DCC bytes into TCA symbols
//************************************************************************************************
// This part translates a DCC byte array into a TCA timer symbol structure.
static void createDccBits() {
  // DCC "1"
  s.one.per = ONE;
  s.one.cmp = ONE / 2;
  // DCC "0"
  s.zero.per = ZERO;
  s.zero.cmp = ZERO / 2;
  // End bit
  s.endbit.per = ONE;
  s.endbit.cmp = ONE / 2;
  // Railcom gap
  s.gap.per = TCE;
  s.gap.cmp = TCS;
};


// Helper functions to push a specific TCA symbol on the buffer
static void pushStartBit(dcc_waveform_symbol_t *buf, int &i) { buf[i++] = s.zero; }
static void pushEndBit(dcc_waveform_symbol_t *buf, int &i) { buf[i++] = s.endbit; }
static void pushRailComGap(dcc_waveform_symbol_t *buf, int &i) { buf[i++] = s.gap; }
static void pushBit(dcc_waveform_symbol_t *buf, int &i, bool bit) { buf[i++] = bit ? s.one : s.zero;}
static void pushByte(dcc_waveform_symbol_t *buf, int &i, uint8_t value) {
  for (int b = 7; b >= 0; b--) { pushBit(buf, i, value & (1 << b)); }
}


static void pushPreamble(dcc_waveform_symbol_t *buf, int &i) {
  if (dccTx.smActive) {
    // Service mode has a longer preamble and no Railcom gap
    for (int p = 0; p < dccTx.preambleLengthSM; p++) pushBit(buf, i, 1);
    }
  else {
    // Normal mode.
    int length = dccTx.preambleLength;
    if (dccTx.railComAllowedOnDcc) {             // We should generate a railcom gap
      pushRailComGap(buf, i);
      length = length - 4;
      for (int p = 0; p < length; p++) pushBit(buf, i, 1);
    }
    else for (int p = 0; p < length; p++) pushBit(buf, i, 1);
  }
}

static void prepareIdlePacket() {
  int i = 0;                                  // counter within the buffer
  pushPreamble(dccTx.idlePacket.symbols, i);
  pushStartBit(dccTx.idlePacket.symbols, i);
  pushByte(dccTx.idlePacket.symbols, i, 0xFF);   // First byte
  pushStartBit(dccTx.idlePacket.symbols, i);
  pushByte(dccTx.idlePacket.symbols, i, 0x00);   // Second byte
  pushStartBit(dccTx.idlePacket.symbols, i);
  pushByte(dccTx.idlePacket.symbols, i, 0xFF);   // XOR byte
  pushEndBit(dccTx.idlePacket.symbols, i);
  dccTx.idlePacket.numberOfSymbols = i;          // number of TCA symbols
}

static void prepareResetPacket() {
  int i = 0;                                  // counter within the buffer
  pushPreamble(dccTx.resetPacket.symbols, i);
  pushStartBit(dccTx.resetPacket.symbols, i);
  pushByte(dccTx.resetPacket.symbols, i, 0x00);  // First byte
  pushStartBit(dccTx.resetPacket.symbols, i);
  pushByte(dccTx.resetPacket.symbols, i, 0x00);  // Second byte
  pushStartBit(dccTx.resetPacket.symbols, i);
  pushByte(dccTx.resetPacket.symbols, i, 0x00);  // XOR byte
  pushEndBit(dccTx.resetPacket.symbols, i);
  dccTx.resetPacket.numberOfSymbols = i;         // number of TCA symbols
}


//================================================================================================
//                             C: RailCom Cutout Timer (TCD)
//================================================================================================
// The TCD timer is enabled in the DCC (TCA) ISR once a new packet is selected for transmission.
// The TCD timer is disabled in the RailCom cutout (TCD) ISR, after TCE is reached.
void inline enableTcdTimer() {
  while(!(TCD0.STATUS & TCD_ENRDY_bm)) {;}
  // Now we may enable the timer
  TCD0.CTRLA |= TCD_ENABLE_bm;
}

void inline disableTcdTimer() {
  while(!(TCD0.STATUS & TCD_ENRDY_bm)) {;}
  TCD0.CTRLA &= ~TCD_ENABLE_bm;
}

// The TCD Waveform Output (WO) is enabled / disabled after setRailComGapInAux is called.
// Since the Railcom gap should be disabled during Service Mode, is is also disabled / enabled
// in enterServiceMode() and leaveServiceMode()
void inline enableTcdWO() {
  if (dccPacketEngine.dccRailAuxPin == PIN_PA4) {
    CPU_CCP = CCP_IOREG_gc;           // Gives us 4 CPU-cycli for the next instruction
    TCD0.FAULTCTRL |= TCD_CMPAEN_bm;  // Enable Compare Unit A (PA4)
  }
  else if (dccPacketEngine.dccRailAuxPin == PIN_PA5) {
    CPU_CCP = CCP_IOREG_gc;
    TCD0.FAULTCTRL |= TCD_CMPBEN_bm;  // Enable Compare Unit B (PA5)
  }
}

void inline disableTcdWO() {
  if (dccPacketEngine.dccRailAuxPin == PIN_PA4) {
    CPU_CCP = CCP_IOREG_gc;
    TCD0.FAULTCTRL &= ~TCD_CMPAEN_bm;  // Disable Compare Unit A (PA4)
  }
  else if (dccPacketEngine.dccRailAuxPin == PIN_PA5) {
    CPU_CCP = CCP_IOREG_gc;
    TCD0.FAULTCTRL &= ~TCD_CMPBEN_bm;  // Disable Compare Unit B (PA5)
  }
}

void initRailComTimer() {
  // If the provided AUX pin cannot be used for TCD WOA output, return!
  if (dccPacketEngine.dccRailAuxPin == 0xFF) return;
  // prevent DxCore to control Timer D
  takeOverTCD0();
  // 1) Select the clock source and the prescaler from the Control A register
  TCD0.CTRLA = TCD_CLKSEL_CLKPER_gc   | // Normal clock, same as CPU
               TCD_SYNCPRES_DIV4_gc   | // SYNC Prescaler divided by 4
               TCD_CNTPRES_DIV1_gc;     // CNT Prescaler of 1
  // 2) Select the Waveform Generation mode from the Control B register
  TCD0.CTRLB = TCD_WGMODE_ONERAMP_gc;
  // 3) Set the interrupt to Overflow (CMPBCLR is reached)
  TCD0.INTCTRL = TCD_OVF_bm;            //  overflow interrupt
  // 4) Event control
  TCD0.EVCTRLA = 0;
  TCD0.EVCTRLB = 0;
  // 5) Write the initial values in the Compare registers
  TCD0.CMPASET = TCD_TCS; // Time before cmpa goes high
  TCD0.CMPBSET = TCD_TCS; // Time before cmpb goes high
  TCD0.CMPACLR = TCD_TCE; // reset time
  TCD0.CMPBCLR = TCD_TCE; // Same as CMPACLR, to avoid early OVF interrupts
 }

ISR(TCD0_OVF_vect) {
  disableTcdTimer();                // Stop the timer
  TCD0.INTFLAGS |= TCD_OVF_bm; // Clear the interrupt flag
}

//================================================================================================
//                               D: TCA Transmission Engine
//================================================================================================
// Everything related to TCA initialisation is put in a separate file
#include "DCCHardware-DxCore-TCA0.inc"


static inline void setPinInverted(volatile uint8_t* pinCtrlReg, bool inverted) {
  // Inverts the polarity of a pin output
  if (inverted) *pinCtrlReg |= PORT_INVEN_bm;
  else *pinCtrlReg &= ~PORT_INVEN_bm;
}


static inline void selectTransmitPacket(DccPacket* packet) {
  // A new packet will be send. Start the RailCom timer first
  if (dccTx.railComActiveOnAux) enableTcdTimer();
  // Select which packet the ISR will transmit next
  tcaTx.activePacket = packet;
  tcaTx.currentSymbolIndex = 0;
}

static inline void procesNextPacket() {
  // We can process a new packet provided we don't have to repeat earlier SM packets
  if (dccPacketEngine.isServiceModeRepeating() == false) {
    // Part 1: No SM repeating.
    if (dccTx.userPacketReady) {                                // set in send()
      // Part 1A: We received a new packet from the user
      // Switch ISR to the buffer that was just filled by send():
      // sendPacketIndex has already been toggled in send(), so "ready" is the other one.
      dccTx.isrPacketIndex = dccTx.sendPacketIndex ^ 1;
      transmitNextPacket(&dccTx.userPacket[dccTx.isrPacketIndex]);
      dccTx.userPacketReady = false;
      if (dccTx.isServiceModePacket) {                          // set in send()
        dccTx.smRepeatsRemaining = dccTx.smMaxRepeats;          // initialise
      }
    } else {
      // No new packet: send the default packet
      transmitNextPacket(dccTx.defaultPacket);
    }
  } else {
    // Part 2: We are in SM and have to repeat the message
    transmitNextPacket(&dccTx.userPacket[dccTx.isrPacketIndex]);
    // Decrement counter (Note: decrease is atomic operation)
    uint8_t repeats = dccTx.smRepeatsRemaining;
    if (repeats > 0) dccTx.smRepeatsRemaining = repeats - 1;
  }
  if (dccTx.smRepeatsRemaining == 0) dccPacketEngine.canAcceptPacket = true;
}

ISR(DCCHandler) {
  // The ISR is called after a complete DCC bit was generated
  _TIMER.INTFLAGS = TCA_SINGLE_OVF_bm;   // Clear the interrupt flag
  uint8_t index = tcaTx.currentSymbolIndex;
  volatile DccPacket* packet = tcaTx.activePacket;
  // Feed next symbol to TCA
  _TIMER.PER = packet->symbols[index].per;
  *tcaTx.compareUnitRegister = packet->symbols[index].cmp;
  // Increase the index to the next symbol
  index = index + 1;
  // Packet finished?
  if (index >= packet->numberOfSymbols) {
    procesNextPacket();                  // will call selectTransmitPacket(...), which resets index
  }
   else {
    tcaTx.currentSymbolIndex = index;
  }
}


static inline void startTcaWaveformGenerator() {
  initTxEngines();         // Set (or reset) state variables to their initial value.
  // For the provided dccRailPin, try to find a port and pin that the TCA compare
  // unit is able to support. If we can't, return.
  if (!initTca(dccPacketEngine.dccRailPin)) {
    dccPacketEngine.dccRailPin = 0xFF;
    return;
  }
  // Start with an idle packet
  selectTransmitPacket(&dccTx.idlePacket);
  dccPacketEngine.canAcceptPacket = true;
}


//================================================================================================
//                                 E: DccPacketEngine class methods
//================================================================================================

//************************************************************************************************
// E1: setUp and Send
//************************************************************************************************
void DccPacketEngine::setupWaveformGenerator() {
  if (dccTx.isInitialized) return;
  // Step1: Set up the Aux pin
  initAuxPin();
  // Step2: create bit symbols and predefined DCC packets
  createDccBits();
  prepareIdlePacket();
  prepareResetPacket();
  // Step 3: Setup the RailCom timer
  initRailComTimer();
  // Step 4: Start the TCA with idle packets
  startTcaWaveformGenerator();
  // Step 5: Initialization is done
  dccTx.isInitialized = true;
}

void DccPacketEngine::send(const uint8_t* data, uint8_t size) {
  // Sends a DCC packet (3..6 bytes including XOR).
  if (size == 0 || size > MaxDccSize) return;   // Illegal packet size
  if (!canAcceptPacket) return;                 // User not allowed to send yet
  canAcceptPacket = false;
  // Select the packet buffer owned by send()
  uint8_t index = dccTx.sendPacketIndex;
  DccPacket& packet = dccTx.userPacket[index];
  // Check if this is a Service Mode packet
  // RCN-216: Service Mode packets have 0111xxxx as first byte
  dccTx.isServiceModePacket = dccTx.smActive && ((data[0] & 0xF0) == 0b01110000);
  // Build the packet into the selected buffer
  int i = 0;                                      // counter within the packet buffer
  pushPreamble(packet.symbols, i);
  for (int b = 0; b < size; b++) {                // Push all user bytes, preceded by a start bit
    pushStartBit(packet.symbols, i);
    pushByte(packet.symbols, i, data[b]);
  }
  pushEndBit(packet.symbols, i);
  // Publish: numberOfSymbols last
  packet.numberOfSymbols = (uint8_t)i;
  // Hand over to ISR
  dccTx.sendPacketIndex ^= 1;                     // switch to the other buffer for the next send()
  dccTx.userPacketReady = true;
}


//******************************************************************************
// E2. Service Mode interface methods
//******************************************************************************
void DccPacketEngine::enterServiceMode(void) {
  // Enable Service Mode behaviour (long preamble, reset packets, SM flow).
  dccTx.smActive = true;
  dccTx.defaultPacket = &dccTx.resetPacket;
}

void DccPacketEngine::leaveServiceMode(void) {
  // The current implementation of DCCPacketScheduler calls leaveServiceMode
  // before every packet, and not, as one might expected, only after Service
  // Mode is over.
  if (dccTx.smActive == false) return;
  // Leave Service Mode immediately. Ongoing SM retransmissions are cancelled.
  dccTx.railComActiveOnAux = dccTx.railComAllowedOnAux;
  dccTx.smRepeatsRemaining = 0;
  dccTx.smActive = false;
  dccTx.defaultPacket = &dccTx.idlePacket;
}

bool DccPacketEngine::isServiceModeEnabled(void) {
  // Returns true if the system is currently in Service Mode.
  return dccTx.smActive;
}

void DccPacketEngine::setServiceModeMaxRepeats(uint8_t value) {
  dccTx.smMaxRepeats = value;
}

bool DccPacketEngine::isFirstServiceModePacket(void) {
  // True only for the first transmission of a new SM packet.
  return dccTx.smActive && (dccTx.smRepeatsRemaining == dccTx.smMaxRepeats);
}

bool DccPacketEngine::isServiceModeRepeating(void) {
  // True while the current SM packet is being retransmitted
  return dccTx.smActive && (dccTx.smRepeatsRemaining > 0);
}

void DccPacketEngine::stopServiceModeRepeats(void) {
  // Stop retransmission of the current SM packet (e.g. after ACK).
  dccTx.smRepeatsRemaining = 0;
}


//******************************************************************************
// E3. Inrush Protection Mode interface methods
//******************************************************************************
// Inrush protection is not implemented for this variant: empty stubs
void DccPacketEngine::enterInrushMode(void) {}
void DccPacketEngine::leaveInrushMode(void) {}
bool DccPacketEngine::isInrushModeEnabled(void) {return false;}


//******************************************************************************
// E.4. RailCom interface methods
//******************************************************************************
// Enable / disable generation of the cutout in the DCC signal on the DCC pin
void DccPacketEngine::setRailCom(bool active) {
  dccTx.railComAllowedOnDcc = active;
  prepareIdlePacket();           // We need to generate new idle / reset packets
  prepareResetPacket();
}


 // Is generation of the RailCom gap on the DCC pin enabled?
bool DccPacketEngine::getRailCom(void) {
  return dccTx.railComAllowedOnDcc;
}

// Enable / disable generation of a RailCom gap pulse on the Aux pin
void DccPacketEngine::setRailComGapInAux(bool useForRcCutout) {
  dccTx.railComAllowedOnAux = useForRcCutout;
  if (dccTx.railComAllowedOnAux) enableTcdWO();     // Attach the WO pins to TCD
  dccTx.railComActiveOnAux = dccTx.railComAllowedOnAux;            // Inform ISR
}

// This routine allows higher-layer software to determine whether a RailCom gap
// is currently in progress, so that rail voltage and/or current measurements
// can be safely controlled. In this driver implementation we check the value
// of the output pin.
bool DccPacketEngine::railComGap(void) {
  dccTx.railComCutoutInProgress = false;
  if (dccTx.railComAllowedOnAux && dccTx.auxOutputActive) {
    bool pinHigh = false;
    if (dccTx.auxPin == PIN_PA4) {
      pinHigh = (PORTA.IN & PIN4_bm) != 0;      // PORTA.IN & PIN4_bm => 0 or 16
    } else if (dccTx.auxPin == PIN_PA5) {
      pinHigh = (PORTA.IN & PIN5_bm) != 0;      // PORTA.IN & PIN5_bm => 0 or 32
    }
    dccTx.railComCutoutInProgress = pinHigh;
  }
  return dccTx.railComCutoutInProgress;
}

//******************************************************************************
// E5: Start / Stop interface methods
//******************************************************************************
// This HQ driver code enables (disables) the signal on the AUX pin. The pin
// can therefore be used to enable (disable) a connected H-Bridge. The
// polarity of the enable signal can be inverted by using setAuxActiveLevel().
// The AUX signal may include the RailCom cutout signal; the gap has the
// same polarity as the disable level.
// The DCC output will never be disabled, allowing switches and other
// accessories to remain operational.

// When StopOutputSignal() is called, the following steps are required:
// - Check dccTx.auxOutputActive and return immediately if the AUX output
//   is already disabled. This flag is used to coordinate RunOutputSignal()
//   and StopOutputSignal().
// - Disable dccTx.railComActiveOnAux. This prevents the TCA ISR from
//   enabling the TCD timer when the next packet starts. Strictly speaking
//   this may not always be required, but it guarantees a well-defined state.
// - Since a RailCom cutout may already be in progress, the TCD timer must
//   be disabled by calling disableTcdTimer(). In principle it would be
//   possible to test whether the cutout is active (for example by reading
//   the AUX pin state), but disableTcdTimer() is fast and safe to call
//   unconditionally.
// - Call disableTcdWO() to detach the AUX pin from the TCD waveform output.
//   This returns control of the pin to the PORT peripheral.
// - Finally call disableAuxOutput() to drive the AUX pin to the inactive
//   level via digitalWriteFast(), thereby disabling the external H-bridge.
void DccPacketEngine::StopOutputSignal() {
  if (!dccTx.auxOutputActive) return;
  dccTx.railComActiveOnAux = false;    // Prevent the timer to start
  disableTcdTimer();                   // Stop the timer, if it just became active
  disableTcdWO();                      // Detach the WO pins from TCD
  dccTx.auxOutputActive = false;
  disableAuxOutput();
}

void DccPacketEngine::RunOutputSignal() {
  if (dccTx.auxOutputActive) return;
  dccTx.auxOutputActive = true;
  enableAuxOutput();
  if (dccTx.railComAllowedOnAux) enableTcdWO();     // Attach the WO pins to TCD
  dccTx.railComActiveOnAux = dccTx.railComAllowedOnAux;            // Inform ISR
}

//******************************************************************************
// E6: Setters to change certain aspects of the DCC encoder
//******************************************************************************
void DccPacketEngine::setDccSignalInverted(bool inverted) {
  // Inverts the polarity of the DCC signal. No impact on AUX signal
  if (dccTx.dccSignalInverted == inverted) return;
  dccTx.dccSignalInverted = inverted;
  setPinInverted(tcaTx.pinCtrlRegister, inverted);
}

void DccPacketEngine::setPreambleLength(uint8_t value) {
  // RCN-211 (23.07.2023): Eine Zentrale muss mindestens 17 Synchronbits senden
  if (value < 17) return;
  dccTx.preambleLength = value;      // Length of normal preamble
}

void DccPacketEngine::setPreambleLengthSM(uint8_t value) {
  // RCN-216 (24.11.2025): im Programmiermodus mindestens 20 Synchronbits
  if (value < 20) return;
  dccTx.preambleLengthSM = value;    // Length of preamble in Service Mode
}

void DccPacketEngine::setAuxActiveLevel(bool activeHigh) {
  setAuxPinInverted(activeHigh);
}

// Not used by this variant
void DccPacketEngine::useMonitorPinforInrush(bool value) {(void)value;}
